## patches/scripts/kconfig/Kconfig.kernel.patch
```kconfig
===== 2026-10-09 22:59:26 =====
diff --git a/scripts/kconfig/Kconfig.kernel b/scripts/kconfig/Kconfig.kernel
index c741f8031..5f4775e41 100755
--- a/scripts/kconfig/Kconfig.kernel
+++ b/scripts/kconfig/Kconfig.kernel
@@ -1,32 +1,32 @@
 #+++++++++++++++++++++++++++++++++++++++++++++++++++
 choice
     prompt "Kernel Version"
-    default LINUX-3.18.y
+### updated by huxm on 2026-10-09
+    default linux-6.12-full
 
-config  LINUX-3.18.y
-    bool "linux-3.18.y"
-    depends on HI3716MV410 || HI3716MV420 || HI3798MV100 || HI3796MV100 || HI3716DV100 || HI3798CV200 || HI3798MV200 || HI3798MV200_A || HI3796MV200
-
-### modify by huxm 20231209
-config  LINUX-4.435
-    bool "linux-4.435"
-    depends on HI3716MV410 || HI3716MV420 || HI3798MV100 || HI3796MV100 || HI3716DV100 || HI3798CV200 || HI3798MV200 || HI3798MV200_A || HI3796MV200
-
-### modify by huxm 20231210 
+### added by huxm on 2023-12-10
 config  LINUX-5.15.134
     bool "linux-5.15.134"
     depends on HI3716MV410 || HI3716MV420 || HI3798MV100 || HI3796MV100 || HI3716DV100 || HI3798CV200 || HI3798MV200 || HI3798MV200_A || HI3796MV200
 
+### added by huxm on 2026-10-09
+config  linux-6.12-full
+    bool "linux-6.12-full"
+    depends on HI3716MV410 || HI3716MV420 || HI3798MV100 || HI3796MV100 || HI3716DV100 || HI3798CV200 || HI3798MV200 || HI3798MV200_A || HI3796MV200
+
 endchoice
 
 config  HI_KERNEL_VERSION
     string
-    default linux-3.18.y if LINUX-3.18.y
-### modify by huxm 20231209
-    default linux-4.435 if LINUX-4.435
-### modify by huxm 20231210
+### updated by huxm on 2026-10-09
+    default linux-6.12-full if linux-6.12-full
+
+### added by huxm on 2023-12-10
     default linux-5.15.134 if LINUX-5.15.134
 
+### added by huxm on 2026-10-09
+    default linux-6.12-full if linux-6.12-full
+
 config  HI_KERNEL_CFG
     prompt "Kernel Config File"
     string
```

## patches/source/kernel/linux-6.12-full/arch/arm/Kconfig.patch
```kconfig
===== 2026-10-11 21:56:10 =====
diff --git a/source/kernel/linux-6.12-full/arch/arm/Kconfig b/source/kernel/linux-6.12-full/arch/arm/Kconfig
index 51c6b2db9..1cd6f3a3b 100644
--- a/source/kernel/linux-6.12-full/arch/arm/Kconfig
+++ b/source/kernel/linux-6.12-full/arch/arm/Kconfig
@@ -1419,6 +1419,23 @@ config DEPRECATED_PARAM_STRUCT
 	  This was deprecated in 2001 and announced to live on for 5 years.
 	  Some old boot loaders still use this way.
 
+# added by huxm on 2026-10-10
+config BUILD_ARM_APPENDED_DTB_IMAGE
+	bool "Build a concatenated zImage/dtb by default"
+	depends on OF
+	help
+	  Enabling this option will cause a concatenated zImage and list of
+	  DTBs to be built by default (instead of a standalone zImage.)
+	  The image will built in arch/arm/boot/zImage-dtb
+
+config BUILD_ARM_APPENDED_DTB_IMAGE_NAMES
+	string "Default dtb names"
+	depends on BUILD_ARM_APPENDED_DTB_IMAGE
+	help
+	  Space separated list of names of dtbs to append when
+	  building a concatenated zImage-dtb.
+# end of added
+
 # Compressed boot loader in ROM.  Yes, we really want to ask about
 # TEXT and BSS so we preserve their values in the config files.
 config ZBOOT_ROM_TEXT
```
